## examples/client/main/Kconfig.projbuild
```kconfig
menu "AX.25 Client Configuration"

    config CLIENT_LOCAL_CALLSIGN
        string "Local Callsign"
        default "N0CALL"
        help
            AX.25 callsign for this station (e.g. N0CALL or N0CALL-1).

    config CLIENT_REMOTE_CALLSIGN
        string "Remote Callsign"
        default "N0CALL-1"
        help
            Callsign of the remote AX.25 host to connect to.

    config CLIENT_UART_NUM
        int "TNC UART Port Number"
        default 1
        range 0 2
        help
            UART peripheral number connected to the TNC (0, 1, or 2).

    config CLIENT_TNC_TX_PIN
        int "TNC UART TX GPIO"
        default 6
        range 0 48
        help
            GPIO number for the UART TX line to the TNC.

    config CLIENT_TNC_RX_PIN
        int "TNC UART RX GPIO"
        default 7
        range 0 48
        help
            GPIO number for the UART RX line from the TNC.

    choice CLIENT_TNC_BAUD_CHOICE
        prompt "TNC UART Baud Rate"
        default CLIENT_TNC_BAUD_57600
        help
            Select a supported UART baud rate for the TNC connection.

        config CLIENT_TNC_BAUD_1200
            bool "1200"

        config CLIENT_TNC_BAUD_2400
            bool "2400"

        config CLIENT_TNC_BAUD_4800
            bool "4800"

        config CLIENT_TNC_BAUD_9600
            bool "9600"

        config CLIENT_TNC_BAUD_19200
            bool "19200"

        config CLIENT_TNC_BAUD_38400
            bool "38400"

        config CLIENT_TNC_BAUD_57600
            bool "57600"

        config CLIENT_TNC_BAUD_115200
            bool "115200"

        config CLIENT_TNC_BAUD_230400
            bool "230400"

        config CLIENT_TNC_BAUD_460800
            bool "460800"

        config CLIENT_TNC_BAUD_921600
            bool "921600"
    endchoice

    config CLIENT_TNC_BAUD
        int
        default 1200 if CLIENT_TNC_BAUD_1200
        default 2400 if CLIENT_TNC_BAUD_2400
        default 4800 if CLIENT_TNC_BAUD_4800
        default 9600 if CLIENT_TNC_BAUD_9600
        default 19200 if CLIENT_TNC_BAUD_19200
        default 38400 if CLIENT_TNC_BAUD_38400
        default 57600 if CLIENT_TNC_BAUD_57600
        default 115200 if CLIENT_TNC_BAUD_115200
        default 230400 if CLIENT_TNC_BAUD_230400
        default 460800 if CLIENT_TNC_BAUD_460800
        default 921600 if CLIENT_TNC_BAUD_921600

    config CLIENT_CONNECT_TIMEOUT_MS
        int "Connect timeout (ms)"
        default 45000
        range 1000 300000
        help
            Maximum time to wait for the AX.25 connection to be established.

    config CLIENT_READ_TIMEOUT_MS
        int "Prompt read timeout (ms)"
        default 120000
        range 1000 600000
        help
            Maximum time to wait for each ENTER COMMAND: prompt.

endmenu
```

## examples/connected_chat/main/Kconfig.projbuild
```kconfig
menu "Connected Chat Configuration"

    config CONNECTED_CHAT_LOCAL_CALLSIGN
        string "Local Callsign"
        default "N0CALL-1"
        help
            AX.25 callsign and SSID for this station (e.g. N0CALL-1).

    config CONNECTED_CHAT_UART_NUM
        int "TNC UART Port Number"
        default 1
        range 0 2
        help
            UART peripheral number connected to the TNC (0, 1, or 2).

    config CONNECTED_CHAT_TNC_TX_PIN
        int "TNC UART TX GPIO"
        default 6
        range 0 48
        help
            GPIO number for the UART TX line to the TNC.

    config CONNECTED_CHAT_TNC_RX_PIN
        int "TNC UART RX GPIO"
        default 7
        range 0 48
        help
            GPIO number for the UART RX line from the TNC.

    choice CONNECTED_CHAT_TNC_BAUD_CHOICE
        prompt "TNC UART Baud Rate"
        default CONNECTED_CHAT_TNC_BAUD_57600
        help
            Select a supported UART baud rate for the TNC connection.

        config CONNECTED_CHAT_TNC_BAUD_1200
            bool "1200"

        config CONNECTED_CHAT_TNC_BAUD_2400
            bool "2400"

        config CONNECTED_CHAT_TNC_BAUD_4800
            bool "4800"

        config CONNECTED_CHAT_TNC_BAUD_9600
            bool "9600"

        config CONNECTED_CHAT_TNC_BAUD_19200
            bool "19200"

        config CONNECTED_CHAT_TNC_BAUD_38400
            bool "38400"

        config CONNECTED_CHAT_TNC_BAUD_57600
            bool "57600"

        config CONNECTED_CHAT_TNC_BAUD_115200
            bool "115200"

        config CONNECTED_CHAT_TNC_BAUD_230400
            bool "230400"

        config CONNECTED_CHAT_TNC_BAUD_460800
            bool "460800"

        config CONNECTED_CHAT_TNC_BAUD_921600
            bool "921600"
    endchoice

    config CONNECTED_CHAT_TNC_BAUD
        int
        default 1200 if CONNECTED_CHAT_TNC_BAUD_1200
        default 2400 if CONNECTED_CHAT_TNC_BAUD_2400
        default 4800 if CONNECTED_CHAT_TNC_BAUD_4800
        default 9600 if CONNECTED_CHAT_TNC_BAUD_9600
        default 19200 if CONNECTED_CHAT_TNC_BAUD_19200
        default 38400 if CONNECTED_CHAT_TNC_BAUD_38400
        default 57600 if CONNECTED_CHAT_TNC_BAUD_57600
        default 115200 if CONNECTED_CHAT_TNC_BAUD_115200
        default 230400 if CONNECTED_CHAT_TNC_BAUD_230400
        default 460800 if CONNECTED_CHAT_TNC_BAUD_460800
        default 921600 if CONNECTED_CHAT_TNC_BAUD_921600

endmenu
```

## examples/connected_chat/sdkconfig.defaults
```kconfig
CONFIG_ESPTOOLPY_FLASHSIZE_4MB=y
CONFIG_PARTITION_TABLE_SINGLE_APP=y
CONFIG_FREERTOS_HZ=1000
CONFIG_ESP_CONSOLE_USB_SERIAL_JTAG=y
```

## examples/kiss_router/main/Kconfig.projbuild
```kconfig
menu "AX.25 Router Configuration"

    config ROUTER_WIFI_ENABLE
        bool "Enable WiFi and TCP KISS server"
        default y
        help
            Connect to a WiFi network and start a TCP KISS server so that
            applications such as Direwolf, pat, and other KISS-over-TCP
            clients can reach the router over the network.  When disabled,
            all WiFi and TCP code is excluded from the build.

    config ROUTER_WIFI_SSID
        string "WiFi SSID"
        default ""
        depends on ROUTER_WIFI_ENABLE
        help
            SSID of the WiFi network to connect to as a station.
            Leave empty to skip station mode and start in AP mode.

    config ROUTER_WIFI_PASSWORD
        string "WiFi Password"
        default ""
        depends on ROUTER_WIFI_ENABLE
        help
            Optional password for WiFi station mode.

    config ROUTER_WIFI_AP_SSID
        string "Fallback AP SSID"
        default "ESP-AX25"
        depends on ROUTER_WIFI_ENABLE
        help
            SSID used when station mode is skipped or cannot connect.

    config ROUTER_WIFI_AP_PASSWORD
        string "Fallback AP Password"
        default ""
        depends on ROUTER_WIFI_ENABLE
        help
            Optional password for fallback AP mode.
            Leave empty to create an open access point.

    config ROUTER_TCP_PORT
        int "TCP KISS server port"
        default 8100
        range 1 65535
        depends on ROUTER_WIFI_ENABLE
        help
            TCP port on which the KISS server listens for incoming clients
            (e.g. Direwolf, pat, or other KISS-over-TCP applications).

    config ROUTER_UART_NUM
        int "UART port number"
        default 1
        range 0 2
        help
            ESP32 UART peripheral number used for the KISS TNC connection
            (0 = UART0, 1 = UART1, 2 = UART2).

    choice ROUTER_UART_BAUD_RATE_CHOICE
        prompt "UART baud rate"
        default ROUTER_UART_BAUD_RATE_57600
        help
            Select a supported UART baud rate for the KISS TNC link.

        config ROUTER_UART_BAUD_RATE_1200
            bool "1200"

        config ROUTER_UART_BAUD_RATE_2400
            bool "2400"

        config ROUTER_UART_BAUD_RATE_4800
            bool "4800"

        config ROUTER_UART_BAUD_RATE_9600
            bool "9600"

        config ROUTER_UART_BAUD_RATE_19200
            bool "19200"

        config ROUTER_UART_BAUD_RATE_38400
            bool "38400"

        config ROUTER_UART_BAUD_RATE_57600
            bool "57600"

        config ROUTER_UART_BAUD_RATE_115200
            bool "115200"

        config ROUTER_UART_BAUD_RATE_230400
            bool "230400"

        config ROUTER_UART_BAUD_RATE_460800
            bool "460800"

        config ROUTER_UART_BAUD_RATE_921600
            bool "921600"
    endchoice

    config ROUTER_UART_BAUD_RATE
        int
        default 1200 if ROUTER_UART_BAUD_RATE_1200
        default 2400 if ROUTER_UART_BAUD_RATE_2400
        default 4800 if ROUTER_UART_BAUD_RATE_4800
        default 9600 if ROUTER_UART_BAUD_RATE_9600
        default 19200 if ROUTER_UART_BAUD_RATE_19200
        default 38400 if ROUTER_UART_BAUD_RATE_38400
        default 57600 if ROUTER_UART_BAUD_RATE_57600
        default 115200 if ROUTER_UART_BAUD_RATE_115200
        default 230400 if ROUTER_UART_BAUD_RATE_230400
        default 460800 if ROUTER_UART_BAUD_RATE_460800
        default 921600 if ROUTER_UART_BAUD_RATE_921600

    config ROUTER_UART_TX_PIN
        int "UART TX GPIO pin"
        default 6
        range 0 48
        help
            GPIO pin wired to the TNC's RXD line (ESP32 transmit).

    config ROUTER_UART_RX_PIN
        int "UART RX GPIO pin"
        default 7
        range 0 48
        help
            GPIO pin wired to the TNC's TXD line (ESP32 receive).

    config ROUTER_BT_ENABLE
        bool "Enable Bluetooth SPP KISS client support"
        default y
        depends on BT_ENABLED
        help
            When enabled, the router accepts a Bluetooth Classic SPP connection
            as a dynamic router port alongside TCP KISS clients.  Hold the
            pairing button (see AX25_PHY_BT_BUTTON_GPIO) for 5 seconds to make
            the device discoverable.

endmenu
```

## examples/monitor/main/Kconfig.projbuild
```kconfig
menu "AX.25 Monitor Configuration"

    config MONITOR_WIFI_SSID
        string "WiFi SSID"
        default ""
        help
            SSID of the WiFi network to connect to as a station.
            Leave empty to skip station mode and start in AP mode.

    config MONITOR_WIFI_PASSWORD
        string "WiFi Password"
        default ""
        help
            Optional password for WiFi station mode.

    config MONITOR_WIFI_AP_SSID
        string "Fallback AP SSID"
        default "ESP-AX25"
        help
            SSID used when station mode is skipped or cannot connect.

    config MONITOR_WIFI_AP_PASSWORD
        string "Fallback AP Password"
        default ""
        help
            Optional password for fallback AP mode.
            Leave empty to create an open access point.

    config MONITOR_SOUNDMODEM_HOST
        string "Soundmodem Host"
        default "192.168.1.100"
        help
            IP address or hostname of the KISS soundmodem or Direwolf server.

    config MONITOR_SOUNDMODEM_PORT
        int "Soundmodem KISS TCP Port"
        default 8100
        range 1 65535
        help
            TCP port on which the soundmodem is listening for KISS connections.
            Direwolf default is 8001.

endmenu
```

## examples/ui_beacon/main/Kconfig.projbuild
```kconfig
menu "UI Beacon Configuration"

    config UI_BEACON_LOCAL_CALLSIGN
        string "Local Callsign"
        default "N0CALL-1"
        help
            AX.25 callsign and SSID for this station (e.g. N0CALL-1).

    config UI_BEACON_DEST
        string "Beacon Destination"
        default "APX100"
        help
            AX.25 destination address for the beacon frame (e.g. APRS-0, BEACON-0).

    config UI_BEACON_MESSAGE
        string "Beacon Message"
        default "ESP32 AX.25 Beacon"
        help
            Text payload included in every beacon UI frame.

    config UI_BEACON_INTERVAL_MS
        int "Beacon Interval (ms)"
        default 60000
        range 1000 3600000
        help
            How often to transmit a beacon, in milliseconds.

    config UI_BEACON_UART_NUM
        int "TNC UART Port Number"
        default 1
        range 0 2
        help
            UART peripheral number connected to the TNC (0, 1, or 2).

    config UI_BEACON_TNC_TX_PIN
        int "TNC UART TX GPIO"
        default 6
        range 0 48
        help
            GPIO number for the UART TX line to the TNC.

    config UI_BEACON_TNC_RX_PIN
        int "TNC UART RX GPIO"
        default 7
        range 0 48
        help
            GPIO number for the UART RX line from the TNC.

    choice UI_BEACON_TNC_BAUD_CHOICE
        prompt "TNC UART Baud Rate"
        default UI_BEACON_TNC_BAUD_57600
        help
            Select a supported UART baud rate for the TNC connection.

        config UI_BEACON_TNC_BAUD_1200
            bool "1200"

        config UI_BEACON_TNC_BAUD_2400
            bool "2400"

        config UI_BEACON_TNC_BAUD_4800
            bool "4800"

        config UI_BEACON_TNC_BAUD_9600
            bool "9600"

        config UI_BEACON_TNC_BAUD_19200
            bool "19200"

        config UI_BEACON_TNC_BAUD_38400
            bool "38400"

        config UI_BEACON_TNC_BAUD_57600
            bool "57600"

        config UI_BEACON_TNC_BAUD_115200
            bool "115200"

        config UI_BEACON_TNC_BAUD_230400
            bool "230400"

        config UI_BEACON_TNC_BAUD_460800
            bool "460800"

        config UI_BEACON_TNC_BAUD_921600
            bool "921600"
    endchoice

    config UI_BEACON_TNC_BAUD
        int
        default 1200 if UI_BEACON_TNC_BAUD_1200
        default 2400 if UI_BEACON_TNC_BAUD_2400
        default 4800 if UI_BEACON_TNC_BAUD_4800
        default 9600 if UI_BEACON_TNC_BAUD_9600
        default 19200 if UI_BEACON_TNC_BAUD_19200
        default 38400 if UI_BEACON_TNC_BAUD_38400
        default 57600 if UI_BEACON_TNC_BAUD_57600
        default 115200 if UI_BEACON_TNC_BAUD_115200
        default 230400 if UI_BEACON_TNC_BAUD_230400
        default 460800 if UI_BEACON_TNC_BAUD_460800
        default 921600 if UI_BEACON_TNC_BAUD_921600

endmenu
```

## test/main/Kconfig.projbuild
```kconfig
menu "AX.25 Test Configuration"
    comment "Stress tests were moved to the dedicated test_stress suite."

endmenu
```

## test_stress/main/Kconfig.projbuild
```kconfig
menu "AX.25 Stress Test Configuration"

    config STRESS_TEST_ENABLE
        bool "Enable stress test"
        default y
        help
            Include the AX.25 stress test in this dedicated stress suite.

    if STRESS_TEST_ENABLE

    config STRESS_TOTAL_CONNECTIONS
        int "Total number of connections to run"
        default 500
        range 1 100000
        help
            Total number of AX.25 connected sessions to complete before the
            test finishes. Each session connects, exchanges a random payload,
            verifies the echo, and disconnects cleanly.

    config STRESS_SIMULTANEOUS_CONNECTIONS
        int "Number of simultaneous connections"
        default 6
        range 1 8
        help
            Number of AX.25 sessions to run in parallel.

    config STRESS_MIN_DATA_SIZE
        int "Minimum payload size per connection (bytes)"
        default 128
        range 1 256
        help
            Smallest random payload size sent over a connected session.

    config STRESS_MAX_DATA_SIZE
        int "Maximum payload size per connection (bytes)"
        default 5120
        range 1 65536
        help
            Largest random payload size sent over a connected session.

    endif # STRESS_TEST_ENABLE

endmenu
```
